#ifndef AES256_TINY_H
#define AES256_TINY_H

#include <stdint.h>
#include <string.h>
#include <avr/pgmspace.h>

// Forward S-box
static const uint8_t aes_sbox[256] PROGMEM = {
  0x63, 0x7c, 0x77, 0x7b, 0xf2, 0x6b, 0x6f, 0xc5, 0x30, 0x01, 0x67, 0x2b, 0xfe, 0xd7, 0xab, 0x76,
  0xca, 0x82, 0xc9, 0x7d, 0xfa, 0x59, 0x47, 0xf0, 0xad, 0xd4, 0xa2, 0xaf, 0x9c, 0xa4, 0x72, 0xc0,
  0xb7, 0xfd, 0x93, 0x26, 0x36, 0x3f, 0xf7, 0xcc, 0x34, 0xa5, 0xe5, 0xf1, 0x71, 0xd8, 0x31, 0x15,
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  0x8c, 0xa1, 0x89, 0x0d, 0xbf, 0xe6, 0x42, 0x68, 0x41, 0x99, 0x2d, 0x0f, 0xb0, 0x54, 0xbb, 0x16
};

// Inverse S-box
static const uint8_t aes_isbox[256] PROGMEM = {
  0x52, 0x09, 0x6a, 0xd5, 0x30, 0x36, 0xa5, 0x38, 0xbf, 0x40, 0xa3, 0x9e, 0x81, 0xf3, 0xd7, 0xfb,
  0x7c, 0xe3, 0x39, 0x82, 0x9b, 0x2f, 0xff, 0x87, 0x34, 0x8e, 0x43, 0x44, 0xc4, 0xde, 0xe9, 0xcb,
  0x54, 0x7b, 0x94, 0x32, 0xa6, 0xc2, 0x23, 0x3d, 0xee, 0x4c, 0x95, 0x0b, 0x42, 0xfa, 0xc3, 0x4e,
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  0x17, 0x2b, 0x04, 0x7e, 0xba, 0x77, 0xd6, 0x26, 0xe1, 0x69, 0x14, 0x63, 0x55, 0x21, 0x0c, 0x7d
};

struct aes256_ctx {
  uint8_t rk[240];
};

static uint8_t aes_xtime(uint8_t x) {
  return (uint8_t)((x << 1) ^ ((x & 0x80) ? 0x1b : 0));
}

__attribute__((noinline))
static void aes256_set_key(uint8_t *rk, const uint8_t *key) {
  memcpy(rk, key, 32);
  uint8_t rcon = 1;
  for (uint8_t i = 8; i < 60; i++) {
    uint8_t t[4];
    memcpy(t, rk + (i - 1) * 4, 4);
    if ((i & 7) == 0) {
      uint8_t tmp = t[0];
      t[0] = pgm_read_byte(aes_sbox + t[1]) ^ rcon;
      t[1] = pgm_read_byte(aes_sbox + t[2]);
      t[2] = pgm_read_byte(aes_sbox + t[3]);
      t[3] = pgm_read_byte(aes_sbox + tmp);
      rcon = aes_xtime(rcon);
    } else if ((i & 7) == 4) {
      t[0] = pgm_read_byte(aes_sbox + t[0]);
      t[1] = pgm_read_byte(aes_sbox + t[1]);
      t[2] = pgm_read_byte(aes_sbox + t[2]);
      t[3] = pgm_read_byte(aes_sbox + t[3]);
    }
    for (uint8_t j = 0; j < 4; j++) {
      rk[i * 4 + j] = rk[(i - 8) * 4 + j] ^ t[j];
    }
  }
}

static void aes_add_round_key(uint8_t *s, const uint8_t *rk) {
  for (uint8_t i = 0; i < 16; i++) s[i] ^= rk[i];
}

static void aes_sub_bytes(uint8_t *s) {
  for (uint8_t i = 0; i < 16; i++) s[i] = pgm_read_byte(aes_sbox + s[i]);
}

static void aes_inv_sub_bytes(uint8_t *s) {
  for (uint8_t i = 0; i < 16; i++) s[i] = pgm_read_byte(aes_isbox + s[i]);
}

static void aes_shift_rows(uint8_t *s) {
  uint8_t t;
  t = s[1]; s[1] = s[5]; s[5] = s[9]; s[9] = s[13]; s[13] = t;
  t = s[2]; s[2] = s[10]; s[10] = t;
  t = s[6]; s[6] = s[14]; s[14] = t;
  t = s[15]; s[15] = s[11]; s[11] = s[7]; s[7] = s[3]; s[3] = t;
}

static void aes_inv_shift_rows(uint8_t *s) {
  uint8_t t;
  t = s[13]; s[13] = s[9]; s[9] = s[5]; s[5] = s[1]; s[1] = t;
  t = s[2]; s[2] = s[10]; s[10] = t;
  t = s[6]; s[6] = s[14]; s[14] = t;
  t = s[3]; s[3] = s[7]; s[7] = s[11]; s[11] = s[15]; s[15] = t;
}

static void aes_mix_columns(uint8_t *s) {
  for (uint8_t i = 0; i < 16; i += 4) {
    uint8_t a = s[i], b = s[i+1], c = s[i+2], d = s[i+3];
    uint8_t t = a ^ b ^ c ^ d;
    s[i]   ^= t ^ aes_xtime(a ^ b);
    s[i+1] ^= t ^ aes_xtime(b ^ c);
    s[i+2] ^= t ^ aes_xtime(c ^ d);
    s[i+3] ^= t ^ aes_xtime(d ^ a);
  }
}

static uint8_t aes_mul(uint8_t a, uint8_t b) {
  uint8_t p = 0;
  for (uint8_t i = 0; i < 8; i++) {
    if (b & 1) p ^= a;
    a = aes_xtime(a);
    b >>= 1;
  }
  return p;
}

static void aes_inv_mix_columns(uint8_t *s) {
  for (uint8_t i = 0; i < 16; i += 4) {
    uint8_t a = s[i], b = s[i+1], c = s[i+2], d = s[i+3];
    s[i]   = aes_mul(a, 0x0e) ^ aes_mul(b, 0x0b) ^ aes_mul(c, 0x0d) ^ aes_mul(d, 0x09);
    s[i+1] = aes_mul(a, 0x09) ^ aes_mul(b, 0x0e) ^ aes_mul(c, 0x0b) ^ aes_mul(d, 0x0d);
    s[i+2] = aes_mul(a, 0x0d) ^ aes_mul(b, 0x09) ^ aes_mul(c, 0x0e) ^ aes_mul(d, 0x0b);
    s[i+3] = aes_mul(a, 0x0b) ^ aes_mul(b, 0x0d) ^ aes_mul(c, 0x09) ^ aes_mul(d, 0x0e);
  }
}

__attribute__((noinline))
static void aes256_encrypt_block(const uint8_t *rk, uint8_t *buf) {
  aes_add_round_key(buf, rk);
  for (uint8_t r = 1; r < 14; r++) {
    aes_sub_bytes(buf);
    aes_shift_rows(buf);
    aes_mix_columns(buf);
    aes_add_round_key(buf, rk + r * 16);
  }
  aes_sub_bytes(buf);
  aes_shift_rows(buf);
  aes_add_round_key(buf, rk + 14 * 16);
}

__attribute__((noinline))
static void aes256_decrypt_block(const uint8_t *rk, uint8_t *buf) {
  aes_add_round_key(buf, rk + 14 * 16);
  for (uint8_t r = 13; r > 0; r--) {
    aes_inv_shift_rows(buf);
    aes_inv_sub_bytes(buf);
    aes_add_round_key(buf, rk + r * 16);
    aes_inv_mix_columns(buf);
  }
  aes_inv_shift_rows(buf);
  aes_inv_sub_bytes(buf);
  aes_add_round_key(buf, rk);
}

__attribute__((noinline))
// Round keys and CBC state live in g_eccHold. A 272-byte ctx on the
// stack runs through the SHA-256 object. The request snapshot has
// already been copied back before any call.
extern uint8_t g_eccHold[];
static bool aes_cbc(uint8_t enc, const uint8_t *key, const uint8_t *iv,
                    uint8_t *data, uint8_t nBlocks) {
  uint8_t *rk = g_eccHold;
  uint8_t *prev = g_eccHold + 240;
  uint8_t *tmp = g_eccHold + 256;
  aes256_set_key(rk, key);
  memcpy(prev, iv, 16);
  for (uint8_t n = 0; n < nBlocks; n++) {
    uint8_t *b = data + (uint8_t)(n * 16);
    if (enc) {
      for (uint8_t j = 0; j < 16; j++) b[j] ^= prev[j];
      aes256_encrypt_block(rk, b);
      memcpy(prev, b, 16);
    } else {
      memcpy(tmp, b, 16);
      aes256_decrypt_block(rk, b);
      for (uint8_t j = 0; j < 16; j++) b[j] ^= prev[j];
      memcpy(prev, tmp, 16);
    }
  }
  memset(rk, 0, 240);
  memset(prev, 0, 16);
  memset(tmp, 0, 16);
  return true;
}

#endif // AES256_TINY_H
